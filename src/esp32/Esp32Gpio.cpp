/**
 **************************************************************************************************
 *
 * @file    : Esp32Gpio.cpp
 * @author  : Oussama Darouez
 * @version : 1.0
 * @date    : February 2024
 * @brief   : ESP32 GPIO Implementation
 * 
 **************************************************************************************************
 * 
 * @project  : {BionicArm}
 * @board    : {esp32dev}
 * @compiler : {gcc-arm-none-eabi}
 * 
 **************************************************************************************************
 *
 */

/*-----------------------------------------------------------------------------------------------*/
/* Includes                                                                                      */
/*-----------------------------------------------------------------------------------------------*/
#include "esp32/Esp32Gpio.h"

/*-----------------------------------------------------------------------------------------------*/
/* Public methods                                                                                */
/*-----------------------------------------------------------------------------------------------*/
/**************************************************************************************************
  * @brief      Constructor for ESP32 GPIO
  * @return     Nothing
  ********************************************************************************************** */
Esp32Gpio::Esp32Gpio(uint8_t pin, uint8_t mode) {
  this->pin = pin;
  this->mode = mode;
}

/**************************************************************************************************
  * @brief      Setup GPIO pin
  * @return     true if setup successful
  ********************************************************************************************** */
bool Esp32Gpio::setup() {
  if (this->pin >= 0) {
    pinMode(this->pin, this->mode);
    return true;
  }
  return false;
}

/**************************************************************************************************
  * @brief      Write to GPIO pin
  * @return     true if write successful
  ********************************************************************************************** */
bool Esp32Gpio::write(uint8_t state) {
  if (this->pin >= 0 && this->mode == OUTPUT) {
    digitalWrite(this->pin, state);
    return true;
  }
  return false;
}

/**************************************************************************************************
  * @brief      Read from GPIO pin
  * @return     true if read successful
  ********************************************************************************************** */
bool Esp32Gpio::read(uint8_t& state) {
  if (this->pin >= 0 && this->mode == INPUT) {
    state = digitalRead(this->pin);
    return true;
  }
  return false;
} 